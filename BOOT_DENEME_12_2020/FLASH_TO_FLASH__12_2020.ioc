# file: FLASH_TO_FLASH__12_2020.ioc
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Mcu.Family=STM32F1
Mcu.Name=STM32F103C(8-B)Tx
Mcu.Package=LQFP48
NVIC.PriorityGroup=NVIC_PRIORITYGROUP_4
PA13.Mode=Serial_Wire
PA13.Signal=SYS_JTMS-SWDIO
PA14.Mode=Serial_Wire
PA14.Signal=SYS_JTCK-SWCLK
PD0-OSC_IN.Mode=HSE-External-Oscillator
PD0-OSC_IN.Signal=RCC_OSC_IN
PD1-OSC_OUT.Mode=HSE-External-Oscillator
PD1-OSC_OUT.Signal=RCC_OSC_OUT
ProjectManager.HeapSize=0x200
ProjectManager.StackSize=0x400
ProjectManager.TargetToolchain=STM32CubeIDE
RCC.AHBFreq_Value=72000000
RCC.APB1CLKDivider=RCC_HCLK_DIV2
RCC.APB1Freq_Value=36000000
RCC.APB1TimFreq_Value=72000000
RCC.APB2Freq_Value=72000000
RCC.APB2TimFreq_Value=72000000
RCC.HCLKFreq_Value=72000000
RCC.PLLMUL=RCC_PLL_MUL9
RCC.PLLSourceVirtual=RCC_PLLSOURCE_HSE
RCC.SYSCLKFreq_VALUE=72000000
RCC.SYSCLKSource=RCC_SYSCLKSOURCE_PLLCLK
RCC.USBFreq_Value=72000000
board=custom

// file: Src/main.c
/* USER CODE BEGIN Header */
/**
  ******************************************************************************
  * @file           : main.c
  * @brief          : Main program body
  ******************************************************************************
  * @attention
  *
  * <h2><center>&copy; Copyright (c) 2020 STMicroelectronics.
  * All rights reserved.</center></h2>
  *
  * This software component is licensed by ST under BSD 3-Clause license,
  * the "License"; You may not use this file except in compliance with the
  * License. You may obtain a copy of the License at:
  *                        opensource.org/licenses/BSD-3-Clause
  *
  ******************************************************************************
  */
/* USER CODE END Header */

#include "main.h"

void SystemClock_Config(void);
static void MX_GPIO_Init(void);
/* USER CODE BEGIN PFP */
void Flash_Copy(uint32_t OKUNACAK_adres,uint32_t YAZILACAK_adres,uint8_t KILO_byte);
/* USER CODE END PFP */

int main(void)
{

  /* MCU Configuration--------------------------------------------------------*/

  /* Reset of all peripherals, Initializes the Flash interface and the Systick. */
  HAL_Init();

  /* Configure the system clock */
  SystemClock_Config();

  /* Initialize all configured peripherals */
  MX_GPIO_Init();
  /* USER CODE BEGIN 2 */

  Flash_Copy(0X08000000,0X08008000,5);  //32 ilk Kbyte lık kısım son 32Kbtye lık kısma kopyalanıyor

  /* USER CODE END 2 */

  /* Infinite loop */
  while (1)
  {

  }
}

void SystemClock_Config(void)
{
  RCC_OscInitTypeDef RCC_OscInitStruct = {0};
  RCC_ClkInitTypeDef RCC_ClkInitStruct = {0};

  /** Initializes the CPU, AHB and APB busses clocks
  */
  RCC_OscInitStruct.OscillatorType = RCC_OSCILLATORTYPE_HSE;
  RCC_OscInitStruct.HSEState = RCC_HSE_ON;
  RCC_OscInitStruct.HSEPredivValue = RCC_HSE_PREDIV_DIV1;
  RCC_OscInitStruct.HSIState = RCC_HSI_ON;
  RCC_OscInitStruct.PLL.PLLState = RCC_PLL_ON;
  RCC_OscInitStruct.PLL.PLLSource = RCC_PLLSOURCE_HSE;
  RCC_OscInitStruct.PLL.PLLMUL = RCC_PLL_MUL9;
  if (HAL_RCC_OscConfig(&RCC_OscInitStruct) != HAL_OK)
  {
    Error_Handler();
  }
  /** Initializes the CPU, AHB and APB busses clocks
  */
  RCC_ClkInitStruct.ClockType = RCC_CLOCKTYPE_HCLK|RCC_CLOCKTYPE_SYSCLK
                              |RCC_CLOCKTYPE_PCLK1|RCC_CLOCKTYPE_PCLK2;
  RCC_ClkInitStruct.SYSCLKSource = RCC_SYSCLKSOURCE_PLLCLK;
  RCC_ClkInitStruct.AHBCLKDivider = RCC_SYSCLK_DIV1;
  RCC_ClkInitStruct.APB1CLKDivider = RCC_HCLK_DIV2;
  RCC_ClkInitStruct.APB2CLKDivider = RCC_HCLK_DIV1;

  if (HAL_RCC_ClockConfig(&RCC_ClkInitStruct, FLASH_LATENCY_2) != HAL_OK)
  {
    Error_Handler();
  }
}

static void MX_GPIO_Init(void)
{

  /* GPIO Ports Clock Enable */
  __HAL_RCC_GPIOD_CLK_ENABLE();
  __HAL_RCC_GPIOA_CLK_ENABLE();

}

/* USER CODE BEGIN 4 */
//**************FLAS OKUMA YAZMA KISMI*******************
uint32_t Read_Flash(uint32_t adr) {
	uint32_t *Pntr = (uint32_t*) adr;
	return (*Pntr);
}
void Unlock_Flash(void)  //FLAS KILIDINI ACMA
{
	FLASH->KEYR = 0x45670123; //flash kilidini acmak i�in keyr ye KEY1 VE KEY2 GIRILIYOR
	FLASH->KEYR = 0xCDEF89AB;
}

void Lock_Flash(void)  //flas yeniden kilitleniyor
{
	FLASH->CR = 0x00000080;
}

void Erase_Flash(uint32_t adr) {
	FLASH->CR |= 0x00000002;           //PER enable
	FLASH->AR = adr;                   //silinecek adres
	FLASH->CR |= 0x00000040;           //STRT enable
	while ((FLASH->SR & 0x00000001));  //busy kontrol ediliyor
	FLASH->CR &= ~0x00000042;          //FLAS->CR ilk konumuna aliniyor(kilit hala acik)

}

void Write_Flash(uint32_t adr, uint16_t data) {
	FLASH->CR |= 0x00000001;           //PG enable
	*(__IO uint16_t*) adr = data;      //istenilen adrese istenilen data yaziliyor
	while ((FLASH->SR & 0x00000001));  //islem bitene kadar busy bekleniyor
}
void Flash_Copy(uint32_t OKUNACAK_adres,uint32_t YAZILACAK_adres,uint8_t KILO_byte) { //BURADA RAMDAKI BOLGE BILGILERI FLASH A KAYDEDILIYOR(64kb tın son 4kb tına)

	uint32_t data;
	uint32_t okunacak_adres = OKUNACAK_adres;;
	uint32_t yazilacak_adres = YAZILACAK_adres;
    uint8_t  kilo_byte=KILO_byte;

    if((OKUNACAK_adres+(1024*KILO_byte)) > YAZILACAK_adres) Error_Handler(); //HATALI YAZMAYI ONLEMEK ICIN

	int x;
	int y;

	for (y = 0; y < kilo_byte; y++) {
		Unlock_Flash();
		Erase_Flash(yazilacak_adres);           //yazlılacak adrese ait ilgili sector siliniyor

		for (x = 0; x < 256; x++) {
			//okuma kısmı
			data = Read_Flash(okunacak_adres);   //okunacak adres bolgesindeki 4 Byte lik bilgi okunuyor
			okunacak_adres += 4;

			//yazma kısmı
			Write_Flash(yazilacak_adres, data);  //flasha ilk 2 Byte si yazılıyor
			yazilacak_adres += 2;
			data = data >> 16;
			Write_Flash(yazilacak_adres, data);  //flasha son 2 Byte si yazılıyor
			yazilacak_adres += 2;
		}
		Lock_Flash();
	}

}

void jumpToApp(const uint32_t address)
{
	const JumpStruct* vector_p = (JumpStruct*)address;

	deinitEverything();

	/* let's do The Jump! */
    /* Jump, used asm to avoid stack optimization */
    asm("msr msp, %0; bx %1;" : : "r"(vector_p->stack_addr), "r"(vector_p->func_p));
}

void deinitEverything()
{
	/*
	 *   MX_GPIO_Init();
  MX_USART1_UART_Init();
  MX_USART2_UART_Init();
  MX_TIM3_Init();
  MX_TIM4_Init();
	 */
	//-- reset peripherals to guarantee flawless start of user application
//	HAL_GPIO_DeInit(LED_GPIO_Port, LED_Pin);
//	HAL_GPIO_DeInit(USB_ENABLE_GPIO_Port, USB_ENABLE_Pin);
//	USBD_DeInit(&hUsbDeviceFS);

//	  __HAL_RCC_GPIOD_CLK_DISABLE();
//	  __HAL_RCC_GPIOA_CLK_DISABLE();
	HAL_RCC_DeInit();
	HAL_DeInit();
	SysTick->CTRL = 0;
	SysTick->LOAD = 0;
	SysTick->VAL = 0;
}

/* USER CODE END 4 */

void Error_Handler(void)
{
}

/************************ (C) COPYRIGHT STMicroelectronics *****END OF FILE****/
